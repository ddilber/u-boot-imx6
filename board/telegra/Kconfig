## board/telegra/Kconfig
```kconfig
if TARGET_TELEGRAUQ7

config SYS_BOARD
        default "telegrauq7"

config SYS_VENDOR
        default "telegra"

config SYS_SOC
	default "mx6"

config SYS_CONFIG_NAME
        default "telegrauq7"

endif
```

## board/telegra/Kconfig.txt
```kconfig
if TARGET_TELEGRAUQ7

config SYS_BOARD
        default "telegra"

config SYS_SOC
	default "mx6"

config SYS_CONFIG_NAME
        default "telegrauq7"

endif
```

## configs/telegrauq7_solo_defconfig
```kconfig
CONFIG_SYS_EXTRA_OPTIONS="IMX_CONFIG=board/telegra/uq7.cfg,MX6S,DDR_MB=256"
CONFIG_ARM=y
CONFIG_TARGET_TELEGRAUQ7=y
```
